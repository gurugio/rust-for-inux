## samples/rust/Kconfig
```kconfig
# SPDX-License-Identifier: GPL-2.0

menuconfig SAMPLES_RUST
	bool "Rust samples"
	depends on RUST
	help
	  You can build sample Rust kernel code here.

	  If unsure, say N.

if SAMPLES_RUST

config SAMPLE_RUST_MINIMAL
	tristate "Minimal"
	help
	  This option builds the Rust minimal module sample.

	  To compile this as a module, choose M here:
	  the module will be called rust_minimal.

	  If unsure, say N.

config SAMPLE_RUST_PRINT
	tristate "Printing macros"
	help
	  This option builds the Rust printing macros sample.

	  To compile this as a module, choose M here:
	  the module will be called rust_print.

	  If unsure, say N.

config SAMPLE_RUST_FS
	tristate "File system"
	help
	  This option builds the Rust file system sample.

	  To compile this as a module, choose M here:
	  the module will be called rust_fs.

	  If unsure, say N.

config SAMPLE_RUST_HOSTPROGS
	bool "Host programs"
	help
	  This option builds the Rust host program samples.

	  If unsure, say N.

config SAMPLE_RUST_LDD02
	tristate "LDD02"
	help
	  This option builds the Rust Linux Device Drivers examples

config SAMPLE_RUST_LDD03
	tristate "LDD03"
	help
	  This option builds the Rust Linux Device Drivers examples

config SAMPLE_RUST_LDD_CH04
	tristate "Linux Device Driver proc in Rust"
	help
	  This option builds the Linux Device Driver examples in Rust.

	  If unsure, say N.

endif # SAMPLES_RUST
```
